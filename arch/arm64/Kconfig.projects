## arch/arm64/Kconfig.projects
```kconfig
config SEC_GTS7L_PROJECT
	default n
	bool "Samsung GTS7L Project"
	help
	  Support for Samsung GTS7L Project
	  
config MACH_GTS7L_USA_SINGLE
	default n
	bool "Samsung GTS7L USA SINGLE"
	help
	  Support for Samsung GTS7L USA SINGLE device.
```
